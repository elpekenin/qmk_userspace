## Kconfig
```kconfig
mainmenu "configuration"

rsource "Kconfig.qmk"

menu "userspace"
    rsource "users/elpekenin/Kconfig"
endmenu
```

## Kconfig.qmk
```kconfig
menu "QMK"

config DYNAMIC_KEYMAP_LAYER_COUNT
    int "dynamic keymap layers"

config EECONFIG_USER_DATA_SIZE
    int "user eeprom size"
    default 0

config HOLD_ON_OTHER_KEY_PRESS
    bool "hold on other key press"

choice
    prompt "layer bitmask size"

    config LAYER_STATE_8BIT
        bool "8 bits"

    config LAYER_STATE_16BIT
        bool "16 bits"

    config LAYER_STATE_32BIT
        bool "32 bits"
endchoice

config TAPPING_TERM
    int "tapping term (ms)"

config ANALOG_DRIVER_REQUIRED
    bool "analog input"

config AUTOCORRECT_ENABLE
    bool "autocorrect"

menuconfig BOOTMAGIC_ENABLE
    bool "bootmagic"

if BOOTMAGIC_ENABLE
    config BOOTMAGIC_ROW
        int "row"
        default 0

    config BOOTMAGIC_COLUMN
        int "column"
        default 0
endif

config DEBUG_ENABLE
    bool "debug (eg: .map file)"

config CONSOLE_ENABLE
    bool "console"

menuconfig DEFERRED_EXEC_ENABLE
    bool "deferred execution"

if DEFERRED_EXEC_ENABLE
    config MAX_DEFERRED_EXECUTORS
        int "executors"
endif

config EXTRAKEY_ENABLE
    bool "extrakey"

config KEY_OVERRIDE_ENABLE
    bool "key override"

config KEYCODE_STRING_ENABLE
    bool "keycode string"

menuconfig QUANTUM_PAINTER_ENABLE
    bool "quantum painter"

if QUANTUM_PAINTER_ENABLE
    config QUANTUM_PAINTER_DEBUG
        bool "debug"

    config QUANTUM_PAINTER_DISPLAY_TIMEOUT
        int "display timeout (ms)"

    config QUANTUM_PAINTER_NUM_FONTS
        int "maximum fonts"

    config QUANTUM_PAINTER_NUM_IMAGES
        int "maximum images"

    config QUANTUM_PAINTER_SUPPORTS_NATIVE_COLORS
        bool "support native colors"
endif

menuconfig RGB_MATRIX_ENABLE
    bool "rgb"

if RGB_MATRIX_ENABLE
    config RGB_MATRIX_DEFAULT_VAL
        int "default val"
        range 0 255

    config RGB_MATRIX_MAXIMUM_BRIGHTNESS
        int "maximum brightness"
        range 0 255

    menu "effects"
        rsource "Kconfig.rgb_effects"
    endmenu
endif

menuconfig SPLIT_KEYBOARD
    bool "split"

if SPLIT_KEYBOARD
    config RPC_M2S_BUFFER_SIZE
        int "master to slave buffer size"
        default 80

    config RPC_S2M_BUFFER_SIZE
        int "slave to master buffer size"
        default RPC_M2S_BUFFER_SIZE

    config SPLIT_ACTIVITY_ENABLE
        bool "sync last activity timestamps"

    config SPLIT_HAPTIC_ENABLE
        bool "trigger haptic feedback on slave side"
        depends on HAPTIC_ENABLE

    menuconfig SPLIT_WATCHDOG_ENABLE
        bool "watchdog"

    if SPLIT_WATCHDOG_ENABLE
        config SPLIT_WATCHDOG_TIMEOUT
            int "timeout"
            default 3000
    endif

    menu "sync"
        config SPLIT_LAYER_STATE_ENABLE
            bool "layer state"

        config SPLIT_LED_STATE_ENABLE
            bool "host led status"

        config SPLIT_MODS_ENABLE
            bool "modifiers state"

        config SPLIT_OLED_ENABLE
            bool "oled on/off state"
            depends on OLED_ENABLE

        config SPLIT_POINTING_ENABLE
            bool "pointing device from slave side"
            depends on POINTING_DEVICE_ENABLE

        config SPLIT_TRANSPORT_MIRROR
            bool "master side matrix"

        config SPLIT_WPM_ENABLE
            bool "wpm"
            depends on WPM_ENABLE
    endmenu
endif

config TAP_DANCE_ENABLE
    bool "tap dance"

config TRI_LAYER_ENABLE
    bool "tri layer"

config UART_DRIVER_REQUIRED
    bool "uart"

config WPM_ENABLE
    bool "wpm"

config XAP_ENABLE
    bool "xap"

endmenu
```

## users/elpekenin/Kconfig
```kconfig
menuconfig SIPO_PINS_ENABLE
    bool "sipo pins"

if SIPO_PINS_ENABLE
    config N_SIPO_PINS
        int "number of outputs"
endif

config AUTOCONF_FW_CHECK
    bool "only draw autoconf settings when new fw is flashed"
    default "n"

rsource "src/logging/Kconfig"

if QUANTUM_PAINTER_ENABLE
    menu "quantum painter"
       rsource "src/qp/Kconfig"
    endmenu
endif

rsource "src/touch/Kconfig"
```

## users/elpekenin/src/Kconfig.keylog
```kconfig
menu "keylog"

config KEYLOG_ENABLE
    bool "enable keylog"

if KEYLOG_ENABLE

config KEYLOG_SIZE
    int "size of array storing keylog"
    default 40

endif

endmenu
```

## users/elpekenin/src/logging/Kconfig
```kconfig
menu "logging"

menuconfig QP_LOG_ENABLE
    bool "quantum painter"
    depends on QUANTUM_PAINTER_ENABLE

if QP_LOG_ENABLE
    config QP_LOG_N_CHARS
        int "size of array storing each line"
        default 70

    config QP_LOG_N_LINES
        int "lines stored"
        default 9

    config QP_LOGGING_UI_REDRAW_INTERVAL
        int "ui draw interval (ms)"
        default 100
endif

menuconfig SPLIT_LOG_ENABLE
    bool "split"

if SPLIT_LOG_ENABLE
    config SPLIT_LOG_BUFFER_SIZE
        int "size of ring buffer"
        default 200

    config SPLIT_LOG_SYNC_DELAY
        int "delay before first sync (ms)"
        default 1000

    config SPLIT_LOG_SYNC_INTERVAL
        int "sync interval (ms)"
        default 3000
endif


menuconfig UART_LOG_ENABLE
    bool "uart"
    depends on UART_DRIVER_REQUIRED

if UART_LOG_ENABLE
    config UART_LOG_BAUD_RATE
        int "baud rate"
        default 9600

    # must be kept in sync with `uart_client_t`
    config UART_CLIENT
        int
        default 0 if UART_CLIENT_NONE
        default 1 if UART_CLIENT_PUTTY

    choice
        prompt "client software"

        default UART_CLIENT_PUTTY

        config UART_CLIENT_NONE
            bool "none"

        config UART_CLIENT_PUTTY
            bool "PuTTY"
    endchoice
endif

menuconfig XAP_LOG_ENABLE
    bool "xap"
    depends on XAP_ENABLE

if XAP_LOG_ENABLE
    config XAP_LOG_BUFFER_SIZE
        int "size of ring buffer"
endif

endmenu
```

## users/elpekenin/src/m5/Kconfig
```kconfig
menuconfig M5_ENABLE
    bool "M5 Atom integration"

if M5_ENABLE
    config M5_DEBUG
        bool "debug"
        default "n"

    config M5_BAUD_RATE
        int "baud rate"
        default 115200
endif
```

## users/elpekenin/src/qp/Kconfig
```kconfig
config QP_ASSETS_SIZE
    int "size of array tracking assets"

menu "ui"
    rsource "ui/Kconfig"
endmenu
```

## users/elpekenin/src/qp/tasks/Kconfig
```kconfig
menuconfig QP_TASK_COMPUTER_STATS_ENABLE
    bool "computer stats"

if QP_TASK_COMPUTER_STATS_ENABLE
    config QP_TASK_COMPUTER_STATS_REDRAW_INTERVAL
        int "draw interval (ms)"

    config QP_TASK_COMPUTER_STATS_SIZE
        int "size of array"

    config QP_TASK_COMPUTER_STATS_TIMEOUT
        int "timeout before removing (ms)"
endif # computer stats

menuconfig QP_TASK_GITHUB_NOTIFICATIONS_ENABLE
    bool "github notifications"

if QP_TASK_GITHUB_NOTIFICATIONS_ENABLE
    config QP_TASK_GITHUB_NOTIFICATIONS_REDRAW_INTERVAL
        int "draw interval (ms)"

    config QP_TASK_GITHUB_NOTIFICATIONS_TIMEOUT
        int "timeout before removing (ms)"
endif # github notifications

menuconfig QP_TASK_HEAP_STATS_ENABLE
    bool "heap stats"

if QP_TASK_HEAP_STATS_ENABLE
    config QP_TASK_HEAP_STATS_REDRAW_INTERVAL
        int "draw interval (ms)"
endif # heap stats

menuconfig QP_TASK_KEYLOG_ENABLE
    bool "keylog"

if QP_TASK_KEYLOG_ENABLE
    config QP_TASK_KEYLOG_REDRAW_INTERVAL
        int "draw interval (ms)"
endif # keylog

menuconfig QP_TASK_LAYER_ENABLE
    bool "layer"

if QP_TASK_LAYER_ENABLE
    config QP_TASK_LAYER_REDRAW_INTERVAL
        int "draw interval (ms)"
endif # layer

menuconfig QP_TASK_LOGGING_ENABLE
    bool "logging"

if QP_TASK_LOGGING_ENABLE
    config QP_TASK_LOGGING_REDRAW_INTERVAL
        int "draw interval (ms)"
endif # logging

config QP_TASK_UPTIME_ENABLE
    bool "uptime"
```

## users/elpekenin/src/qp/ui/Kconfig
```kconfig
if XAP_ENABLE
    menu "computer stats"
        config COMPUTER_STATS_SIZE
            int "size of array"
            default 30

        config COMPUTER_STATS_UI_REDRAW_INTERVAL
            int "draw interval (ms)"
            default 500

        config COMPUTER_STATS_UI_TIMEOUT
            int "timeout before removing (ms)"
            default 5000
    endmenu
endif

menu "build match"
    config BUILD_MATCH_UI_REDRAW_INTERVAL
        int "id sync draw interval (ms)"
        default 500
        # depends on SPLIT_ENABLE
endmenu

if XAP_ENABLE
    menu "github notifications"
        config GITHUB_NOTIFICATIONS_UI_REDRAW_INTERVAL
            int "draw interval (ms)"
            default 500

        config GITHUB_NOTIFICATIONS_UI_TIMEOUT
            int "timeout before removing (ms)"
            default 5000
    endmenu
endif
```
